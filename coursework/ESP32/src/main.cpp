#include <Arduino.h>
#include <WiFi.h>
#include <esp_ota_ops.h>
#include <esp_sleep.h>
#include "secrets.h"
#include "version.h"
#include "mqtt/mqtt.h"
#include "dht/dht.h"
#include "ldr/ldr.h"
#include "led/led.h"
#include "button/button.h"
#include "ota/ota.h"
#include "wdt/wdt.h"
#include "shadow/shadow.h"

// ═══════════════════════════════════════════════════════════
// ПАМʼЯТЬ, ЩО ПЕРЕЖИВАЄ СОН
//
// RTC_DATA_ATTR кладе змінну у 8 КБ RTC-памʼяті — єдине, що лишається
// під живленням у Deep Sleep. Тільки глобальні/static, тільки прості
// типи. Ініціалізація нижче виконується ЛИШЕ при подачі живлення,
// після пробудження — ні. Будь-який РЕСЕТ (не пробудження) чистить її.
// ═══════════════════════════════════════════════════════════
RTC_DATA_ATTR int  bootCount    = 0;
RTC_DATA_ATTR int  sleepSeconds = 30;    // скільки спати між циклами — керується з тіні
RTC_DATA_ATTR char indicator[8] = "off"; // бажаний стан LED — так само з тіні

#define WAIT_JOB_MS    2000  // скільки чекаємо відповідь про роботу (і заразом команду)
#define WAIT_SHADOW_MS 500   // окреме, коротше вікно під тінь — див. shadow_wait_for_delta()

// Викликається з work_cycle() і як idle-callback з net.cpp під час
// Wi-Fi/NTP-очікування — інакше кнопка "не працює", поки йде підключення.
static void checkButton() {
    if (button_pressed()) {
        Serial.println("[Кнопка] Натиснуто");
    }
}

// ═══════════════════════════════════════════════════════════
// ПІДТВЕРДЖЕННЯ ОБРАЗУ: «я не просто завантажився — я працюю»
//
// Ядро зібране з CONFIG_BOOTLOADER_APP_ROLLBACK_ENABLE=y: кожен новий
// образ отримує випробувальний термін (PENDING_VERIFY), і будь-який
// РЕСЕТ до підтвердження відкочує слот назад (ABORTED).
//
// Arduino за замовчуванням підтверджує образ САМ, ще до setup(), у
// initArduino() — «дожив до setup()» = «прийнято назавжди». Прошивка,
// яка стартує, але не може підключитись до MQTT, буде підтверджена —
// і пристрій більше ніколи не отримає наступне OTA (воно приходить
// через MQTT). Тому рішення забираємо собі: verifyRollbackLater()
// повертає true — «не підтверджуй, я вирішу сам».
//
// extern "C" обовʼязковий: ядро оголошує цю функцію в C-файлі як
// «слабку» (weak). Без extern "C" компілятор C++ дасть їй інше імʼя,
// ядро її не побачить і мовчки підтвердить образ саме.
// ═══════════════════════════════════════════════════════════
extern "C" bool verifyRollbackLater() {
    return true;
}

// ═══════════════════════════════════════════════════════════
// СОН. Виноситься в функцію, бо викликається з трьох місць:
// нормальне завершення циклу, відсутність мережі, збій MQTT.
//
// Пристрій, який не зміг підключитись, МУСИТЬ заснути. Інакше він
// лишиться в активному режимі на ~160 мА і висадить батарею за добу,
// нічого при цьому не роблячи. Невдача — теж привід спати.
// ═══════════════════════════════════════════════════════════
static void go_to_sleep() {
    if (otaInProgress) {
        Serial.println("[SLEEP] Йде OTA — не спимо");
        return;
    }

    // Гасимо індикацію ДО фінального друку — led_set() сам логує в Serial,
    // а після flush() друкувати вже не можна.
    led_set("off");

    // ═══ ЗАКРИВАЄМО МЕРЕЖУ ═══
    // Wi-Fi драйвер має власні задачі й переривання. Іти в сон з живим
    // радіо — напрошуватись на проблеми при вході в критичну секцію.
    // Плюс це просто правильно енергетично: радіо має згаснути.
    mqtt_disconnect_for_ota();   // DISCONNECT + net.stop()
    WiFi.mode(WIFI_OFF);         // esp_wifi_stop() усередині — цього досить

    // Драйверу Wi-Fi треба кілька десятків мілісекунд, щоб згорнути
    // свої задачі. Заходити в критичну секцію сну раніше — просити біди.
    delay(100);

    Serial.print("[SLEEP] Засинаємо на ");
    Serial.print(sleepSeconds);
    Serial.println(" с");

    // ОСТАННІЙ РЯДОК ПЕРЕД СНОМ. Після flush() друкувати вже не можна:
    // байти, що лишились у TX-буфері UART, у сон не поїдуть.
    Serial.flush();

    // Без цього рядка сну в Wokwi не буде: симулятор зупиняє ЦП, але
    // таймери групи продовжують рахувати, і watchdog робить ресет
    // замість пробудження. На залізі виклик нічого не змінює.
    // Розбір, чому саме так, — у src/wdt/wdt.cpp.
    wdt_silence_for_sleep();

    // Оці два рядки і є Deep Sleep: керування сюди більше не
    // повертається, а через sleepSeconds чіп стартує з нуля —
    // з новим setup() і з живою RTC-памʼяттю.
    esp_sleep_enable_timer_wakeup((uint64_t)sleepSeconds * 1000000ULL);
    esp_deep_sleep_start();
}

// ═══════════════════════════════════════════════════════════
// ОДНЕ ПРОБУДЖЕННЯ = ОДИН ПРОХІД ЦІЄЇ ФУНКЦІЇ.
//
// setup() викликає її рівно раз: у кінці ми засинаємо, а пробудження —
// це новий старт з нуля, тобто новий setup().
//
// Окремо від setup() вона живе через єдиний виняток: якщо йде OTA,
// заснути не можна, і цикл доводиться повторювати з loop().
// ═══════════════════════════════════════════════════════════
static void work_cycle() {
    bootCount++;

    // Три числа, які розрізняють усі сценарії за одну секунду:
    //   розділ app1 + причина 8 (DEEPSLEEP) → оновились (OTA) або просто
    //                                          прокинулись за таймером —
    //                                          розрізняти по bootCount
    //   розділ app0 після оновлення        → відкотились
    //   причина 5 (INT_WDT) / 6 (TASK_WDT) → watchdog під час запису OTA
    // Коди: 1 POWERON, 3 SW, 4 PANIC, 5 INT_WDT, 6 TASK_WDT, 8 DEEPSLEEP
    Serial.printf("ESP32 — версія %s, розділ %s, причина ресету %d, пробудження %d\n",
                  FIRMWARE_VERSION,
                  esp_ota_get_running_partition()->label,
                  (int)esp_reset_reason(),
                  bootCount);

    // ── ВІДНОВЛЮЄМО ФАКТИЧНИЙ СТАН ──
    // Deep Sleep знеструмлює GPIO — світлодіод гасне сам собою. Якщо
    // цього не зробити, вийде брехня: у reported тіні написано "on",
    // а лампочка фізично не горить. AWS не побачить різниці
    // (desired == reported) і дельту не надішле — світло вже ніколи
    // не увімкнеться. Тінь має відповідати реальності, а реальність
    // після сну треба відтворювати руками.
    led_set(indicator);

    if (!mqtt_begin()) {
        Serial.println("[MAIN] Мережа недоступна — спимо до наступної спроби");
        go_to_sleep();
        return;
    }

    if (!mqtt_connect()) {
        Serial.println("[MAIN] MQTT не підключився — спимо до наступної спроби");
        go_to_sleep();
        return;
    }

    // Критерій життя тут: дійшли до цього рядка, тобто Wi-Fi піднявся,
    // час синхронізовано, MQTT підключено. Підтверджуємо ДО сну —
    // пробудження з Deep Sleep це РЕСЕТ, а непідтверджений образ на
    // будь-якому ресеті відкочується сам (bootloader бачить
    // PENDING_VERIFY без підтвердження → ABORTED). Окремий таймер на
    // підтвердження, як на Занятті 15, тут уже не потрібен: наступний
    // ресет і так або підтверджений, або відкочений автоматично.
    esp_ota_mark_app_valid_cancel_rollback();
    Serial.println("[OTA] Образ підтверджено — rollback скасовано");

    // ── Який стан має бути? ──
    // Публікуємо запит заздалегідь, а не перед самим чеканням — поки
    // йде очікування робіт нижче (mqtt_wait_for_job тримає сокет
    // відкритим і читає його), відповідь тіні вже може встигнути
    // дійти. Та покладатись лише на це вікно НЕ можна: воно виходить,
    // щойно прийде відповідь про роботу (а та зазвичай швидша за
    // тінь), тому нижче є ще окреме коротке чекання саме під тінь.
    shadow_request();

    // Чи є робота (OTA)? Запит уже опублікований усередині
    // mqtt_connect(). Той самий цикл очікування заразом ловить і
    // LED-команду, якщо вона прилетіла в це вікно — mqtt_poll()
    // усередині викликає спільний callback.
    mqtt_wait_for_job(WAIT_JOB_MS);

    const char* job = mqtt_take_job();
    if (job) {
        // успіх   → рестарт усередині (сном), сюди не повернемось
        // невдача → повернемось, otaInProgress уже знято
        ota_handle_job(job);
    }

    checkButton();

    float lux = ldr_read_lux();
    float temperature, humidity;
    bool  dhtOk = dht_read(temperature, humidity);
    if (dhtOk) {
        mqtt_publish_telemetry(THINGNAME, temperature, humidity, lux);
    } else {
        Serial.println("[Помилка] DHT22: сенсор повернув некоректні дані (NaN) — пропускаємо публікацію");
    }

    // Якщо відповідь вже встигла прийти під час mqtt_wait_for_job() —
    // ця функція побачить shadowReady==true й вийде миттєво. Якщо ні —
    // дає тіні ще трохи часу окремо, перш ніж здатись до наступного
    // пробудження.
    shadow_wait_for_delta(WAIT_SHADOW_MS);

    // bootCount == 1 — щойно після POWERON/перепрошивки: RTC-памʼять
    // чиста (indicator/sleepSeconds — заводські значення), а AWS досі
    // памʼятає СТАРИЙ reported із попереднього життя пристрою. Якщо той
    // старий reported випадково збігається з desired — delta не прийде
    // ВЗАГАЛІ (AWS чесно вважає все вже синхронізованим), і фактичний
    // стан після перепрошивки ніколи не виправиться сам. Тому на першому
    // пробудженні звітуємо примусово — навіть без дельти — щоб AWS
    // перерахував delta від актуального стану вже на наступному заході.
    bool mustReport = (bootCount == 1);

    ShadowDelta delta;
    if (shadow_take_delta(&delta)) {

        if (delta.hasIndicator) {
            strncpy(indicator, delta.indicator, sizeof(indicator) - 1);
            indicator[sizeof(indicator) - 1] = '\0';
            led_set(indicator);
        }

        if (delta.hasInterval) {
            sleepSeconds = delta.interval;
            Serial.print("[MAIN] Новий інтервал сну: ");
            Serial.println(sleepSeconds);
        }

        mustReport = true;
    }

    if (mustReport) {
        shadow_report(indicator, sleepSeconds);
    }

    // ── Старий канал команд ──
    // Могла прилетіти, поки ми крутили poll в очікуваннях вище. Чесне
    // обмеження: доходить лише якщо її опублікували саме в це вузьке
    // вікно. Лишаємо канал живим (FastAPI поки й так шле в обидва
    // місця), але основне керування тепер — тінь вище.
    const char* cmd = mqtt_take_command();
    if (cmd) {
        led_handle_command(cmd);
    }

    go_to_sleep();
}

// ═══════════════════════════════════════════════════════════
// Тут лишається тільки те, що робиться РІВНО ОДИН РАЗ за вмикання:
// UART і піни периферії. Усе інше — робота одного пробудження.
// ═══════════════════════════════════════════════════════════
void setup() {
    Serial.begin(115200);
    delay(500);

    led_begin();
    button_begin();
    dht_begin();
    ldr_begin();

    work_cycle();
}

// ═══════════════════════════════════════════════════════════
// Майже завжди недосяжний: esp_deep_sleep_start() не повертає
// керування, а пробудження стартує з setup().
//
// Єдиний шлях сюди — go_to_sleep() вийшла без сну, бо йде OTA.
// Без цього пристрій лишався б в активному режимі на ~160 мА
// НАЗАВЖДИ. Тому тут не заглушка, а спроба заснути далі.
// ═══════════════════════════════════════════════════════════
void loop() {
    if (otaInProgress) {
        mqtt_poll();
        delay(1000);
        return;
    }

    work_cycle();
}
